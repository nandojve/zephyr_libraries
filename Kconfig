## Kconfig
```kconfig
# Copyright (c) 2022 Gerson Fernando Budke <nandojve@gmail.com>
#
# SPDX-License-Identifier: Apache-2.0
#

menu "C Drivers"

rsource "drivers/Kconfig"

endmenu

menu "C++ Components"

rsource "components/Kconfig"

endmenu
```
